## targets/baremetal-sdk/curie-bsp/jerry_app/quark/defconfig
```kconfig
CONFIG_AUTO_SERVICE_INIT=y
CONFIG_CFW_QUARK_SE_HELPERS=y
CONFIG_CONSOLE_MANAGER=y
CONFIG_DEBUG_PANIC_TCMD=y
CONFIG_FACTORY_DATA_WRITE=y
CONFIG_FACTORY_DATA=y
CONFIG_INTEL_QRK_AON_PT=y
CONFIG_INTEL_QRK_RTC=y
CONFIG_INTEL_QRK_SPI=y
CONFIG_INTEL_QRK_WDT=y
CONFIG_LOG_CBUFFER_SIZE=2048
CONFIG_LOG_CBUFFER=y
CONFIG_MEMORY_POOLS_BALLOC_STATISTICS=y
CONFIG_MEMORY_POOLS_BALLOC_TRACK_OWNER=y
CONFIG_MEM_POOL_DEF_PATH="$(PROJECT_PATH)/quark"
CONFIG_OS_ZEPHYR=y
CONFIG_PANIC_ON_BUS_ERROR=y
CONFIG_QUARK_SE_PROPERTIES_STORAGE=y
CONFIG_QUARK=y
CONFIG_SERVICES_QUARK_SE_ADC=y
CONFIG_SERVICES_QUARK_SE_GPIO_IMPL=y
CONFIG_SERVICES_QUARK_SE_GPIO=y
CONFIG_SOC_FLASH=y
CONFIG_SOC_GPIO_32=y
CONFIG_SOC_GPIO=y
CONFIG_SOC_ROM=y
CONFIG_SPI_FLASH_W25Q16DV=y
CONFIG_STORAGE_TASK=y
CONFIG_TCMD_CONSOLE=y
CONFIG_TCMD_MASTER=y
CONFIG_TCMD=y
CONFIG_UART_NS16550=y
CONFIG_UART_PM_NS16550=y
CONFIG_ZEPHYR_BOARD="arduino_101"
CONFIG_CONSOLE_HANDLER_SHELL=y
```

## targets/curie_bsp/jerry_app/arc/defconfig
```kconfig
CONFIG_AUTO_SERVICE_INIT=y
CONFIG_CFW_PROXY=y
CONFIG_CFW_QUARK_SE_HELPERS=y
CONFIG_LOG_SLAVE=y
CONFIG_MEM_POOL_DEF_PATH="$(PROJECT_PATH)/arc"
CONFIG_OS_ZEPHYR=y
CONFIG_SERVICES_QUARK_SE_ADC_IMPL=y
CONFIG_SERVICES_QUARK_SE_GPIO_IMPL=y
CONFIG_SOC_GPIO_AON=y
CONFIG_SOC_GPIO=y
CONFIG_SS_ADC=y
CONFIG_SS_GPIO=y
CONFIG_TCMD_SLAVE=y
CONFIG_TCMD=y
CONFIG_ZEPHYR_BOARD="arduino_101_sss"
CONFIG_CONSOLE_HANDLER_SHELL=y
```

## targets/nuttx-stm32f4/Kconfig
```kconfig
#
# For a description of the syntax of this configuration file,
# see the file kconfig-language.txt in the NuttX tools repository.
#

config JERRYSCRIPT
	bool "Jerryscript"
	default n
	---help---
		Enable Jerryscript ECMAScript 5.1 interpreter

if JERRYSCRIPT

config JERRYSCRIPT_PROGNAME
	string "Program name"
	default "jerry"
	depends on BUILD_KERNEL
	---help---
		This is the name of the program that will be
		 use when the NSH ELF program is installed.

config JERRYSCRIPT_PRIORITY
	int "Jerryscript task priority"
	default 100

config JERRYSCRIPT_STACKSIZE
	int "Jerryscript stack size"
	default 16384

config JERRYSCRIPT_HEAPSIZE
	int "Jerryscript heap size"
	default 107520

config JERRYSCRIPT_MEM_STATS
	bool "Enable memory statistics"
	default n

config JERRYSCRIPT_SHOW_OPCODES
	bool "Enable parser byte-code dumps"
	default n

config JERRYSCRIPT_DEBUGGER
	bool "Jerryscript debugger"
	default n

if JERRYSCRIPT_DEBUGGER
config JERRYSCRIPT_DEBUGGER_PORT
	int "Jerryscript debugger port"
	default 5001
endif

endif
```

## targets/os/nuttx/Kconfig
```kconfig
#
# For a description of the syntax of this configuration file,
# see the file kconfig-language.txt in the NuttX tools repository.
#

config INTERPRETERS_JERRYSCRIPT
	bool "Jerryscript JavaScript engine"
	default n

if INTERPRETERS_JERRYSCRIPT

config INTERPRETERS_JERRYSCRIPT_PRIORITY
	int "Jerryscript priority"
	default 100

config INTERPRETERS_JERRYSCRIPT_STACKSIZE
	int "Jerryscript stack size"
	default 16384

endif # INTERPRETERS_JERRYSCRIPT
```

## targets/tizenrt-artik053/apps/jerryscript/Kconfig
```kconfig
#
# For a description of the syntax of this configuration file,
# see the file kconfig-language.txt in the NuttX tools repository.
#

config JERRYSCRIPT
	bool "Jerryscript"
	default n
	---help---
		Enable Jerryscript ECMAScript 5.1 interpreter

if JERRYSCRIPT

config JERRYSCRIPT_PROGNAME
	string "Program name"
	default "jerry"
	depends on BUILD_KERNEL
	---help---
		This is the name of the program that will be
		 use when the NSH ELF program is installed.

config JERRYSCRIPT_PRIORITY
	int "Jerryscript task priority"
	default 100

config JERRYSCRIPT_STACKSIZE
	int "Jerryscript stack size"
	default 16384

endif # JERRYSCRIPT
```
